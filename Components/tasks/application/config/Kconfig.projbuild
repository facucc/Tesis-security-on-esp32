## Components/tasks/application/config/Kconfig.projbuild
```kconfig
config APP_ENABLE
	bool "Enable Application Task"
	default n
	help
		Enable or disable the Application task in the project.

config APP_STACK_SIZE
	int "Application Stack Size"
	default 3000
	help
		Define the stack size for the Application task.

config APP_TASK_NAME
	string "application Task Name"
	default "app"
	help
		Define the name of the application task.

choice FRAMESIZE
	bool "Select Frame Size"
	default FRAMESIZE_VGA
	help
		Select Picture Frame Size.

	config FRAMESIZE_VGA
		bool "Frame Size:640x480"
	config FRAMESIZE_SVGA
		bool "Frame Size:800x600"
	config FRAMESIZE_XGA
		bool "Frame Size:1024x768"
	config FRAMESIZE_HD
		bool "Frame Size:1280x720"
	config FRAMESIZE_SXGA
		bool "Frame Size:1280x1024"
	config FRAMESIZE_UXGA
		bool "Frame Size:1600x1200"
endchoice

config ENABLE_STACK_WATERMARK
	bool "Enable stack watermark"
	default true
	help
		Enable or disable stack watermark.
```

## Components/tasks/cert_renew_agent/config/Kconfig.projbuild
```kconfig
config CERT_RENEWAL_AGENT_ENABLE
    bool "Enable Certificate Renewal Agent Task"
    default n
    help
        Enable or disable the Certificate Renewal Agent task in the project.

if CERT_RENEWAL_AGENT_ENABLE

    config CERT_RENEWAL_AGENT_TASK_NAME
        string "Certificate Renewal Agent Task Name"
        default "cert_renew_agent"
        help
            Define the name of the Certificate Renewal Agent task.

    config CERT_RENEWAL_AGENT_STACK_SIZE
        int "Certificate Renewal Agent Stack Size"
        default 9000
        help
            Define the stack size for the Certificate Renewal Agent task.

    config ENABLE_STACK_WATERMARK
        bool "Enable stack watermark"
        default true
        help
            Enable or disable stack watermark.
endif
```

## Components/tasks/mqtt_agent/config/Kconfig.projbuild
```kconfig
config MQTT_AGENT_ENABLE
	bool "Enable MQTT Agent Task"
	default y
	help
		Enable or disable the MQTT Agent task in the project.

if MQTT_AGENT_ENABLE

	config MQTT_AGENT_TASK_NAME
		string "MQTT Agent Task Name"
		default "mqtt_agent"
		help
			Define the name of the MQTT Agent task.

	config MQTT_AGENT_STACK_SIZE
		int "MQTT Agent Stack Size"
		default 8600
		help
			Define the stack size for the MQTT Agent task.

	config CONNECTION_TEST
		bool "Enable Connection Debug"
		default n

	config ENABLE_STACK_WATERMARK
		bool "Enable stack watermark"
		default true
		help
			Enable or disable stack watermark.

endif
```

## Components/tasks/ota_agent/config/Kconfig.projbuild
```kconfig
config OTA_AGENT_ENABLE
	bool "Enable OTA Agent Task"
	default n
	help
		Enable or disable the OTA Agent task in the project.

if OTA_AGENT_ENABLE

	config OTA_AGENT_TASK_NAME
		string "OTA Agent Task Name"
		default "ota_agent"
		help
			Define the name of the OTA Agent task.

	config OTA_AGENT_STACK_SIZE
		int "OTA Agent Stack Size"
		default 6000
		help
			Define the stack size for the OTA Agent task.

	config ENABLE_STACK_WATERMARK
		bool "Enable stack watermark"
		default true
		help
			Enable or disable stack watermark.
endif
```

## main/Kconfig.projbuild
```kconfig
menu "Tasks Configuration"

    menu "Application"
        source "/home/facundo/Desktop/Tesis/Tesis-security-on-esp32/Components/tasks/application/config/Kconfig.projbuild"         
    endmenu

    menu "MQTT Agent"
        source "/home/facundo/Desktop/Tesis/Tesis-security-on-esp32/Components/tasks/mqtt_agent/config/Kconfig.projbuild"
    endmenu

    menu "Certificate Renewal Agent"
        source "/home/facundo/Desktop/Tesis/Tesis-security-on-esp32/Components/tasks/cert_renew_agent/config/Kconfig.projbuild"
    endmenu

    menu "OTA Agent"
        source "/home/facundo/Desktop/Tesis/Tesis-security-on-esp32/Components/tasks/ota_agent/config/Kconfig.projbuild"
    endmenu

endmenu
```

## sdkconfig.defaults
```kconfig
CONFIG_BOARD_ESP32CAM_AITHINKER=y

CONFIG_CAMERA_JPEG_MODE_FRAME_SIZE_AUTO=y
# Serial flasher config
#
CONFIG_ESPTOOLPY_FLASHFREQ_80M=y
CONFIG_ESPTOOLPY_FLASHSIZE_4MB=y

#
# Partition Table
#
CONFIG_PARTITION_TABLE_CUSTOM=y
CONFIG_PARTITION_TABLE_CUSTOM_FILENAME="custom-partition-table.csv"
CONFIG_PARTITION_TABLE_FILENAME="custom-partition-table.csv"

#
# ESP32-specific
#
CONFIG_ESP32_DEFAULT_CPU_FREQ_240=y
CONFIG_ESP32_DEFAULT_CPU_FREQ_MHZ=240
CONFIG_ESP32_SPIRAM_SUPPORT=y

#
# Camera configuration
#
#CONFIG_OV7670_SUPPORT=y
#CONFIG_OV7725_SUPPORT=y
#CONFIG_NT99141_SUPPORT=y
CONFIG_OV2640_SUPPORT=y
#CONFIG_OV3660_SUPPORT=y
#CONFIG_OV5640_SUPPORT=y
CONFIG_CAMERA_NO_AFFINITY=y
CONFIG_SCCB_HARDWARE_I2C_PORT0=y
```
